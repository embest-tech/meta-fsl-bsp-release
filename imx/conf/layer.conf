## imx/conf/layer.conf
```bitbake
# We have a conf and classes directory, add to BBPATH
BBPATH .= ":${LAYERDIR}"

# We have a packages directory, add to BBFILES
BBFILES += "${LAYERDIR}/meta-fsl-arm/recipes-*/*/*.bb \
            ${LAYERDIR}/meta-fsl-arm/recipes-*/*/*.bbappend"

BBFILES += "${LAYERDIR}/meta-fsl-demos/recipes-*/*/*.bb \
            ${LAYERDIR}/meta-fsl-demos/recipes-*/*/*.bbappend"

BBFILE_COLLECTIONS += "fsl-bsp-release"
BBFILE_PATTERN_fsl-bsp-release := "^${LAYERDIR}"
BBFILE_PRIORITY_fsl-bsp-release = "8"

# Preferred Providers
PREFERRED_PROVIDER_u-boot_mx6 = "u-boot-imx"
PREFERRED_PROVIDER_virtual/libgal_mx6 = "gpu-viv-bin-mx6q"

# Preferred Versions
PREFERRED_VERSION_linux-imx_mx6 = "3.5.7-1.0.0"
PREFERRED_VERSION_imx-lib_mx6 = "3.5.7-1.0.0"
PREFERRED_VERSION_imx-test_mx6 = "3.5.7-1.0.0"
PREFERRED_VERSION_firmware-imx_mx6 = "3.5.7-1.0.0"

PREFERRED_VERSION_gst-fsl-plugin  = "3.5.7-1.0.0"
PREFERRED_VERSION_libfslparser  = "3.5.7-1.0.0"
PREFERRED_VERSION_libfslcodec  = "3.5.7-1.0.0"
PREFERRED_VERSION_libfslvpuwrap = "3.5.7-1.0.0"

PREFERRED_VERSION_gpu-viv-bin-mx6q = "3.5.7-1.1.0${FP_TAG}"
PREFERRED_VERSION_xf86-video-imxfb-vivante = "3.5.7-1.0.0"
##PREFERRED_VRESION_xserver-xorg-video-imx-viv = "3.5.7-1.0.0"

FP_TAG = "${@base_contains("TUNE_FEATURES", "callconvention-hard", "-hfp", "-sfp", d)}"
```

## imx/meta-fsl-arm/conf/layer.conf
```bitbake
# We have a conf and classes directory, add to BBPATH
BBPATH .= ":${LAYERDIR}"

# We have a packages directory, add to BBFILES
BBFILES += "${LAYERDIR}/recipes-*/*/*.bb \
            ${LAYERDIR}/recipes-*/*/*.bbappend"

BBFILE_COLLECTIONS += "fsl-bsp-release"
BBFILE_PATTERN_fsl-bsp-release := "^${LAYERDIR}"
BBFILE_PRIORITY_fsl-bsp-release = "8"

# Preferred Providers
PREFERRED_PROVIDER_u-boot_mx6 = "u-boot-imx"
PREFERRED_PROVIDER_virtual/libgal_mx6 = "gpu-viv-bin-mx6q"

# Preferred Versions
PREFERRED_VERSION_u-boot-imx_mx6 = "2013-04"
PREFERRED_VERSION_linux-imx_mx6 = "3.5.7-1.0.0"
PREFERRED_VERSION_imx-lib_mx6 = "3.5.7-1.0.0"
PREFERRED_VERSION_imx-test_mx6 = "3.5.7-1.0.0"
PREFERRED_VERSION_firmware-imx_mx6 = "3.5.7-1.0.0"

PREFERRED_VERSION_gst-fsl-plugin  = "3.5.7-1.0.0"
PREFERRED_VERSION_libfslparser  = "3.5.7-1.0.0"
PREFERRED_VERSION_libfslcodec  = "3.5.7-1.0.0"
PREFERRED_VERSION_libfslvpuwrap = "3.5.7-1.0.0"

PREFERRED_VERSION_libfslaacpcodec = "3.5.7-1.0.0"
PREFERRED_VERSION_libfslac3codec = "3.5.7-1.0.0"
PREFERRED_VERSION_libfslmsparser = "3.5.7-1.0.0"
PREFERRED_VERSION_libfslmscodec = "3.5.7-1.0.0"
PREFERRED_VERSION_fsl-alsa-plugins = "3.5.7-1.0.0"
PREFERRED_VERSION_gst-plugins-gl = "3.5.7-1.0.0"

DEFAULTTUNE_mx6 = "cortexa9hf-neon"
FP_TAG = "${@base_contains("TUNE_FEATURES", "callconvention-hard", "-hfp", "-sfp", d)}"

PREFERRED_VERSION_gpu-viv-bin-mx6q = "3.5.7-1.0.0${FP_TAG}"
PREFERRED_VERSION_xf86-video-imxfb-vivante = "3.5.7-1.0.0"
PREFERRED_VERSION_xf86-dri-vivante = "3.5.7-1.0.0"

# Fix uboot issues with mx6dlsabresd for package recipes to see
UBOOT_SUFFIX_mx6dl = "imx"
UBOOT_PADDING_mx6dl = "0"

## add the Device tree for mx6dlsabresd
KERNEL_DEVICETREE_mx6dl = "${S}/arch/arm/boot/dts/imx6dl-sabresd.dts"

# Add missing firmware sets for all chip sets
MACHINE_EXTRA_RRECOMMENDS_append_mx6q = " firmware-imx-vpu-imx6q firmware-imx-ath6k"
MACHINE_EXTRA_RRECOMMENDS_append_mx6dl = " firmware-imx-vpu-imx6d firmware-imx-ath6k"
MACHINE_EXTRA_RRECOMMENDS_append_mx6s = " firmware-imx-ath6k"

FSL_ARM_GIT_SERVER ?= "git.freescale.com/imx"
```

## imx/meta-fsl-arm/conf/machine/imx6dlsabreauto-eim-nor.conf
```bitbake
#@TYPE: Machine
#@NAME: i.MX6DL SABRE Auto
#@DESCRIPTION: Machine configuration for Freescale i.MX6DL SABRE Auto EIM-NOR boot

include conf/machine/include/imx-base.inc
include conf/machine/include/tune-cortexa9.inc
include conf/machine/include/fsl-mx6-common.inc

## Note this is mx6dlsabreauto SOC so that imx6dlsabresd changes in layer.conf are not picked up for imx6dlsabreauto
SOC_FAMILY = "mx6:mx6dl:mx6dlsabreauto"

KERNEL_DEVICETREE_mx6dlsabreauto = "${S}/arch/arm/boot/dts/imx6dl-sabreauto.dts"

UBOOT_MACHINE_mx6dlsabreauto = "mx6dlsabreauto_eimnor_config"

SERIAL_CONSOLE = "115200 ttymxc3"

IMAGE_FSTYPES = "tar.bz2"
```

## imx/meta-fsl-arm/conf/machine/imx6dlsabreauto-nand.conf
```bitbake
#@TYPE: Machine
#@NAME: i.MX6DL SABRE Auto
#@DESCRIPTION: Machine configuration for Freescale i.MX6DL SABRE Auto NAND boot

include conf/machine/include/imx-base.inc
include conf/machine/include/tune-cortexa9.inc

SOC_FAMILY = "mx6:mx6dl:mx6dlsabreauto"

KERNEL_DEVICETREE_mx6dlsabreauto = "${S}/arch/arm/boot/dts/imx6dl-sabreauto.dts"

UBOOT_MACHINE_mx6dlsabreauto = "mx6dlsabreauto_nand_config"

SERIAL_CONSOLE = "115200 ttymxc3"

MACHINE_FEATURES += " pci wifi bluetooth"

IMAGE_FSTYPES = "tar.bz2"
```

## imx/meta-fsl-arm/conf/machine/imx6dlsabresd.conf
```bitbake
#@TYPE: Machine
#@NAME: i.MX6DL SABRE SD
#@DESCRIPTION: Machine configuration for Freescale i.MX6DL SABRE SD

include conf/machine/include/imx-base.inc
include conf/machine/include/tune-cortexa9.inc
include conf/machine/include/fsl-mx6-common.inc

#Note this is an update machine conf for imx6dlsabresd which exists in community meta-fsl-arm layer
SOC_FAMILY = "mx6:mx6dl"

PREFERRED_PROVIDER_u-boot = "u-boot-imx"

KERNEL_DEVICETREE = "${S}/arch/arm/boot/dts/imx6dl-sabresd.dts"

UBOOT_MACHINE = "mx6dl_sabresd_config"
```

## imx/meta-fsl-arm/conf/machine/imx6qsabreauto.conf
```bitbake
#@TYPE: Machine
#@NAME: i.MX6Q SABRE Auto
#@DESCRIPTION: Machine configuration for Freescale i.MX6Q SABRE Auto

include conf/machine/include/imx-base.inc
include conf/machine/include/tune-cortexa9.inc
include conf/machine/include/fsl-mx6-common.inc

# Note this is an update machine conf file for one that exists in community meta-fsl-arm layer
SOC_FAMILY = "mx6:mx6q"

KERNEL_DEVICETREE = "${S}/arch/arm/boot/dts/imx6q-sabreauto.dts"

UBOOT_MACHINE = "mx6qsabreauto_config"

SERIAL_CONSOLE = "115200 ttymxc3"
```

## imx/meta-fsl-arm/conf/machine/imx6qsabresd.conf
```bitbake
#@TYPE: Machine
#@NAME: i.MX6Q SABRE SD
#@DESCRIPTION: Machine configuration for Freescale i.MX6Q SABRE SD

include conf/machine/include/imx-base.inc
include conf/machine/include/tune-cortexa9.inc
include conf/machine/include/fsl-mx6-common.inc

#Note this is an updated machine conf file for a machine that exists in community meta-fsl-arm layer
SOC_FAMILY = "mx6:mx6q"

KERNEL_DEVICETREE = "${S}/arch/arm/boot/dts/imx6q-sabresd.dts"

UBOOT_MACHINE = "mx6qsabresd_config"

SERIAL_CONSOLE = "115200 ttymxc0"
```

## imx/meta-fsl-arm/conf/machine/imx6solosabreauto-eim-nor.conf
```bitbake
#@TYPE: Machine
#@NAME: i.MX6Solo SABRE Auto
#@DESCRIPTION: Machine configuration for Freescale i.MX6Solo SABRE Auto EIM-NOR boot

include conf/machine/include/imx-base.inc
include conf/machine/include/tune-cortexa9.inc

SOC_FAMILY = "mx6:mx6solo"

KERNEL_DEVICETREE = "${S}/arch/arm/boot/dts/imx6dl-sabreauto.dts"

UBOOT_MACHINE = " mx6solosabreauto_eimnor_config"

SERIAL_CONSOLE = "115200 ttymxc0"

MACHINE_FEATURES += " pci wifi bluetooth"

IMAGE_FSTYPES = "tar.bz2"
```

## imx/meta-fsl-arm/conf/machine/imx6solosabreauto-nand.conf
```bitbake
#@TYPE: Machine
#@NAME: i.MX6Solo SABRE Auto
#@DESCRIPTION: Machine configuration for Freescale i.MX6Solo SABRE Auto NAND boot

include conf/machine/include/imx-base.inc
include conf/machine/include/tune-cortexa9.inc

SOC_FAMILY = "mx6:mx6solo"

KERNEL_DEVICETREE = "${S}/arch/arm/boot/dts/imx6dl-sabresd.dts"

UBOOT_MACHINE = " mx6solosabresd_nand_config"

SERIAL_CONSOLE = "115200 ttymxc0"

MACHINE_FEATURES += " pci wifi bluetooth"

IMAGE_FSTYPES = "tar.bz2"
```

## imx/meta-fsl-arm/conf/machine/imx6solosabresd.conf
```bitbake
#@TYPE: Machine
#@NAME: i.MX6Solo SABRE SD
#@DESCRIPTION: Machine configuration for Freescale i.MX6Solo SABRE SD

include conf/machine/include/imx-base.inc
include conf/machine/include/tune-cortexa9.inc
include conf/machine/include/fsl-mx6-common.inc

SOC_FAMILY = "mx6:mx6s"

KERNEL_DEVICETREE = "${S}/arch/arm/boot/dts/imx6dl-sabresd.dts"

UBOOT_MACHINE = " mx6solosabresd_config"

SERIAL_CONSOLE = "115200 ttymxc0"
```

## imx/meta-fsl-arm/conf/machine/include/fsl-mx6-common.inc
```bitbake
# Provides the i.MX mx6 Freescale board common settings

DEFAULTTUNE_mx6 = "cortexa9hf-neon"

## Note the imx-base appends vpu firmware so not including it here
## Note sdma firmware from firmware-imx is not needed on mx6
MACHINE_FIRMWARE = " firmware-imx-ath6k"

SERIAL_CONSOLE = "115200 ttymxc3"

MACHINE_FEATURES += " pci wifi bluetooth"
```
